## src/Kconfig.projbuild
```kconfig
menu "ESP32-S3 Infer"

config WIFI_SSID
    string "WiFi SSID (trong = phat AP)"
    default ""

config WIFI_PASSWORD
    string "WiFi password"
    default ""

config WIFI_MAX_RETRY
    int "So lan thu ket noi truoc khi chuyen sang AP"
    default 5

config AP_SSID
    string "SSID cua AP du phong"
    default "ESP32S3-INFER"

config AP_PASSWORD
    string "Mat khau AP du phong (>= 8 ky tu, trong = mo)"
    default "12345678"

config CAM_XCLK_MHZ
    int "OV7670 XCLK (MHz)"
    range 5 20
    default 10
    help
        10 MHz on dinh hon voi day jump. Co the tang len 20 neu day ngan.

config CAM_CLKRC
    int "OV7670 CLKRC prescaler (FPS cam bien = max / (gia tri + 1))"
    range 0 31
    default 1

config CAM_JPEG_QUALITY
    int "JPEG quality stream (5..63, so nho = chat luong cao)"
    range 5 63
    default 12

endmenu
```
